.syntax unified
.cpu cortex-m0plus
.thumb

.section .boot, "ax"

.byte 0x00, 0xb5, 0x32, 0x4b, 0x21, 0x20, 0x58, 0x60, 0x98, 0x68, 0x02, 0x21, 0x88, 0x43, 0x98, 0x60
.byte 0xd8, 0x60, 0x18, 0x61, 0x58, 0x61, 0x2e, 0x4b, 0x00, 0x21, 0x99, 0x60, 0x04, 0x21, 0x59, 0x61
.byte 0x01, 0x21, 0xf0, 0x22, 0x99, 0x50, 0x2b, 0x49, 0x19, 0x60, 0x01, 0x21, 0x99, 0x60, 0x35, 0x20
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.byte 0x00, 0x00, 0x00, 0x00, 0x00, 0x00, 0x00, 0x00, 0x00, 0x00, 0x00, 0x00, 0x07, 0x0b, 0x8f, 0xd5


.section .vectors, "ax"
.align 2

.global __vectors, __VECTOR_TABLE
__VECTOR_TABLE:
__vectors:
.word _stack_top
.word irq_handler_reset


.text
.type irq_handler_reset,%function
.thumb_func
.global irq_handler_reset
irq_handler_reset:
ldr r0,=_stack_top
msr msp, r0
bl startup

.type isr_svcall, %function
.global isr_svcall
isr_svcall:
mrs r0, msp
blx svccall_handler_c
bx lr


.text
.globl  disable
.globl  restore
.globl  enable
.globl  pause
.globl  halt


/*------------------------------------------------------------------------
 * disable  -  Disable interrupts and return the previous state
 *------------------------------------------------------------------------
 */
disable:
    MRS     R0, PRIMASK
    CPSID   I
    BX      LR

/*------------------------------------------------------------------------
 * restore  -  Restore interrupts to value given by mask argument
   Cortex M3 hardware handles a lot, rewrite
 *------------------------------------------------------------------------
 */
restore:
   MSR     PRIMASK, R0
   BX      LR

/*------------------------------------------------------------------------
 * enable  -  Enable interrupts
 *------------------------------------------------------------------------
 */
enable:
    cpsie   i       /* Enable interrupts            */
    bx  lr      /* Return               */

/*------------------------------------------------------------------------
 * pause or halt  -  Place the processor in a hard loop
 *------------------------------------------------------------------------
 */
halt:
pause:
    cpsid   i       /* Disable interrupts       */
dloop:  b   dloop       /* Dead loop            */

 

 

 
.align 4
.force_thumb
.global __aeabi_idiv
__aeabi_idiv:
    ldr r3, =0xD0000000
    str r0, [r3, #0x68]
    str r1, [r3, #0x6C]
    b 1f
1:  b 1f
1:  b 1f
1:  b 1f
1:  ldr r0, [r3, #0x70]
    bx lr


 
.align 4
.force_thumb
.global __aeabi_idivmod
__aeabi_idivmod:
    ldr r3, =0xD0000000
    str r0, [r3, #0x68]
    str r1, [r3, #0x6C]
    b 1f
1:  b 1f
1:  b 1f
1:  b 1f
1:  ldr r0, [r3, #0x74]
    bx lr


 
.align 4
.force_thumb
.global __aeabi_uidiv
__aeabi_uidiv:
    ldr r3, =0xD0000000
    str r0, [r3, #0x60]
    str r1, [r3, #0x64]
    b 1f
1:  b 1f
1:  b 1f
1:  b 1f
1:  ldr r0, [r3, #0x70]
    bx lr


 
.align 4
.force_thumb
.global __aeabi_uidivmod
__aeabi_uidivmod:
    ldr r3, =0xD0000000
    str r0, [r3, #0x60]
    str r1, [r3, #0x64]
    b 1f
1:  b 1f
1:  b 1f
1:  b 1f
1:  ldr r0, [r3, #0x74]
    bx lr



 
.align 0
.force_thumb
.syntax unified
.global __gnu_thumb1_case_uqi
.thumb_func
.type __gnu_thumb1_case_uqi,function
__gnu_thumb1_case_uqi:
push    {r1}
mov r1, lr
lsrs    r1, r1, #1
lsls    r1, r1, #1
ldrb    r1, [r1, r0]
lsls    r1, r1, #1
add lr, lr, r1
pop {r1}
bx  lr
.size __gnu_thumb1_case_uqi, . - __gnu_thumb1_case_uqi

 
.align 0
.force_thumb
.syntax unified
.global __gnu_thumb1_case_uhi
.thumb_func
.type __gnu_thumb1_case_uhi,function
__gnu_thumb1_case_uhi:
push    {r0, r1}
mov r1, lr
lsrs    r1, r1, #1
lsls    r0, r0, #1
lsls    r1, r1, #1
ldrh    r1, [r1, r0]
lsls    r1, r1, #1
add lr, lr, r1
pop {r0, r1}
bx  lr
.size __gnu_thumb1_case_uhi, . - __gnu_thumb1_case_uhi

